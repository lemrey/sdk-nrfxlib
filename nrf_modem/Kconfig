## nrf_modem/Kconfig
```kconfig
# Selected by NRF_MODEM_LIB in sdk-nrf
config NRF_MODEM
	bool
	imply FPU_SHARING

menu "nrf_modem (Modem library)"
	visible if NRF_MODEM

choice NRF_MODEM_BUILD_STRATEGY
	depends on NRF_MODEM
	prompt "Build strategy"

config NRF_MODEM_LINK_BINARY
	bool "Link binary"
	select NRF_MODEM_LINKABLE
endchoice

choice NRF_MODEM_LINK_BINARY_LOCATION
	depends on NRF_MODEM_LINK_BINARY
	prompt "Location of the Modem library binaries"
	default NRF_MODEM_LINK_BINARY_NRFXLIB

config NRF_MODEM_LINK_BINARY_NRFXLIB
	bool "Link nrfxlib binary"

endchoice

choice NRF_MODEM_FLAVOR
	prompt "Choose library flavour"
	default NRF_MODEM_DEFAULT

config NRF_MODEM_DEFAULT
	bool "default"
	help
	  Link with the default binary.

config NRF_MODEM_LOG
	bool "with logs"
	help
	  Link with the binary capable of emitting logs.
endchoice

endmenu

# This configuration is auto-generated.
# Do not edit.
config NRF_MODEM_SHMEM_CTRL_SIZE
	hex
	default 0x4e8 # import
```
